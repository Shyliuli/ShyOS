/* generated by grok-4.5<noreply@x.ai> @ pi
 * QEMU virt / bare-metal RISC-V 链接脚本
 * 入口在 0x80200000（OpenSBI FW_JUMP 默认 kernel 加载地址）
 */

ENTRY(_start)

SECTIONS
{
    . = 0x80200000;

    .text : {
        KEEP(*(.text.shyos_start))
        *(.text .text.*)
    }

    .rodata : {
        *(.rodata .rodata.*)
    }

    .data : {
        *(.data .data.*)
        *(.sdata .sdata.*)
    }

    .bss : {
        sbss = .;
        *(.sbss .sbss.*)
        *(.bss .bss.*)
        *(COMMON)
        ebss = .;
    }

    /DISCARD/ : {
        *(.note*)
        *(.comment)
        *(.eh_frame*)
    }
}
